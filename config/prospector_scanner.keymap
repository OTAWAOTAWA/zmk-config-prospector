/*
 * Copyright (c) 2024 The ZMK Contributors
 *
 * SPDX-License-Identifier: MIT
 */


#include <behaviors.dtsi>
#include <dt-bindings/zmk/keys.h>

/ {
    keymap {
        compatible = "zmk,keymap";

        default_layer {
            // Scanner device with minimal input - use none for display-only device
            bindings = <
                &none  // No key action needed for scanner
            >;
        };
    };
};
