## build-scanner/Kconfig/Kconfig.modules
```kconfig
menu "prospector-zmk-module (/home/ogu/workspace/prospector/zmk-config-prospector/modules/prospector-zmk-module)"
osource "/home/ogu/workspace/prospector/zmk-config-prospector/modules/prospector-zmk-module/Kconfig"
config ZEPHYR_PROSPECTOR_ZMK_MODULE_MODULE
	bool
	default y
endmenu
menu "nanopb (/home/ogu/workspace/prospector/zmk-config-prospector/modules/lib/nanopb)"
osource "$(ZEPHYR_NANOPB_KCONFIG)"
config ZEPHYR_NANOPB_MODULE
	bool
	default y
endmenu
menu "acpica (/home/ogu/workspace/prospector/zmk-config-prospector/modules/lib/acpica)"
osource "$(ZEPHYR_ACPICA_KCONFIG)"
config ZEPHYR_ACPICA_MODULE
	bool
	default y
endmenu
menu "canopennode (/home/ogu/workspace/prospector/zmk-config-prospector/modules/lib/canopennode)"
osource "$(ZEPHYR_CANOPENNODE_KCONFIG)"
config ZEPHYR_CANOPENNODE_MODULE
	bool
	default y
endmenu
menu "cmsis (/home/ogu/workspace/prospector/zmk-config-prospector/modules/hal/cmsis)"
osource "$(ZEPHYR_CMSIS_KCONFIG)"
config ZEPHYR_CMSIS_MODULE
	bool
	default y
endmenu
menu "cmsis-dsp (/home/ogu/workspace/prospector/zmk-config-prospector/modules/lib/cmsis-dsp)"
osource "$(ZEPHYR_CMSIS_DSP_KCONFIG)"
config ZEPHYR_CMSIS_DSP_MODULE
	bool
	default y
endmenu
menu "cmsis-nn (/home/ogu/workspace/prospector/zmk-config-prospector/modules/lib/cmsis-nn)"
osource "$(ZEPHYR_CMSIS_NN_KCONFIG)"
config ZEPHYR_CMSIS_NN_MODULE
	bool
	default y
endmenu
menu "fatfs (/home/ogu/workspace/prospector/zmk-config-prospector/modules/fs/fatfs)"
osource "$(ZEPHYR_FATFS_KCONFIG)"
config ZEPHYR_FATFS_MODULE
	bool
	default y
endmenu
menu "hal_ambiq (/home/ogu/workspace/prospector/zmk-config-prospector/modules/hal/ambiq)"
osource "$(ZEPHYR_HAL_AMBIQ_KCONFIG)"
config ZEPHYR_HAL_AMBIQ_MODULE
	bool
	default y
endmenu
menu "hal_espressif (/home/ogu/workspace/prospector/zmk-config-prospector/modules/hal/espressif)"
osource "/home/ogu/workspace/prospector/zmk-config-prospector/modules/hal/espressif/zephyr/Kconfig"
config ZEPHYR_HAL_ESPRESSIF_MODULE
	bool
	default y
endmenu
menu "hal_ethos_u (/home/ogu/workspace/prospector/zmk-config-prospector/modules/hal/ethos_u)"
osource "$(ZEPHYR_HAL_ETHOS_U_KCONFIG)"
config ZEPHYR_HAL_ETHOS_U_MODULE
	bool
	default y
endmenu
menu "hal_gigadevice (/home/ogu/workspace/prospector/zmk-config-prospector/modules/hal/gigadevice)"
osource "$(ZEPHYR_HAL_GIGADEVICE_KCONFIG)"
config ZEPHYR_HAL_GIGADEVICE_MODULE
	bool
	default y
endmenu
menu "hal_nordic (/home/ogu/workspace/prospector/zmk-config-prospector/modules/hal/nordic)"
osource "$(ZEPHYR_HAL_NORDIC_KCONFIG)"
config ZEPHYR_HAL_NORDIC_MODULE
	bool
	default y
endmenu
menu "hal_rpi_pico (/home/ogu/workspace/prospector/zmk-config-prospector/modules/hal/rpi_pico)"
osource "$(ZEPHYR_HAL_RPI_PICO_KCONFIG)"
config ZEPHYR_HAL_RPI_PICO_MODULE
	bool
	default y
endmenu
menu "hal_telink (/home/ogu/workspace/prospector/zmk-config-prospector/modules/hal/telink)"
osource "/home/ogu/workspace/prospector/zmk-config-prospector/modules/hal/telink/Kconfig"
config ZEPHYR_HAL_TELINK_MODULE
	bool
	default y
endmenu
menu "module (/home/ogu/workspace/prospector/zmk-config-prospector/zmk/app/module)"
osource "/home/ogu/workspace/prospector/zmk-config-prospector/zmk/app/module/Kconfig"
config ZEPHYR_MODULE_MODULE
	bool
	default y
endmenu
```

## build-scanner/Kconfig/Kconfig.shield.defconfig
```kconfig
osource "/home/ogu/workspace/prospector/zmk-config-prospector/modules/prospector-zmk-module/boards/shields/*/Kconfig.defconfig"
osource "/home/ogu/workspace/prospector/zmk-config-prospector/zmk/app/boards/shields/*/Kconfig.defconfig"
```

## build_adapter/Kconfig/Kconfig.shield
```kconfig
osource "/home/ogu/workspace/prospector/zmk-config-prospector/modules/prospector-zmk-module/boards/shields/*/Kconfig.shield"
osource "/home/ogu/workspace/prospector/zmk-config-prospector/zmk/app/boards/shields/*/Kconfig.shield"
```

## config/west.yml
```yaml
manifest:
  remotes:
    - name: zmkfirmware
      url-base: https://github.com/zmkfirmware
    - name: prospector
      url-base: https://github.com/t-ogura
  projects:
    - name: zmk
      remote: zmkfirmware
      revision: main
      import: app/west.yml
    - name: prospector-zmk-module
      remote: prospector
      revision: e7404e6a1f23c8b7d6e9f0a5b2c3d4e8a1f9b6c7
      path: modules/prospector-zmk-module
  self:
    path: config
```
